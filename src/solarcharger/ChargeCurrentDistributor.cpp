// SPDX-License-Identifier: GPL-2.0-or-later
#include <solarcharger/ChargeCurrentDistributor.h>
#include <algorithm>
#include <cmath>
#include <numeric>

namespace SolarChargers {

std::vector<float> ChargeCurrentDistributor::distribute(float chargeLimit, float chargeCurrent,
                                                        std::vector<ControllerData> const& controllers)
{
    size_t const N = controllers.size();
    auto const fN = static_cast<float>(N);

    // sum up the total current all MPPT controllers are currently producing;
    // this is the combined output flowing into the battery and to any inverters
    float overallChargeCurrent = 0.0f;
    for (auto const& c : controllers) {
        overallChargeCurrent += c.batteryCurrent;
    }

    // the battery charge limit (chargeLimit) only constrains current flowing
    // into the battery, but MPPT controllers may simultaneously feed inverters.
    // inverter load is the difference between total MPPT output and the actual
    // battery charge current reported by the BMS. since inverter current is not
    // stored in the battery it does not consume battery capacity, so we add it
    // back to the effective budget we can distribute across the controllers.
    float adjustedLimit = chargeLimit;
    float const inverterCurrent = overallChargeCurrent - chargeCurrent;
    if (inverterCurrent > 0.0f) {
        adjustedLimit += inverterCurrent;
    }

    // near-capacity shortcut (inspired by Victron's dbus-systemcalc-py / DVCC):
    // when the battery's requested charge limit is at or above 95 % of the
    // combined hardware maximum, set every controller to its own hardware
    // maximum. this avoids unnecessary register writes and hunting behaviour
    // near the top of the operating range.
    // intentionally uses chargeLimit (not adjustedLimit): inverter load must
    // not influence this check, as it could cause the shortcut to fire when
    // the battery limit is near zero, flooding the battery with excess current.
    // the shortcut only activates when every controller has reported its maximum,
    // because without all values we cannot reliably compute the 95 % threshold.
    bool const allHaveCapacity = std::all_of(controllers.begin(), controllers.end(),
                                             [](ControllerData const& c) { return c.maxCurrent.has_value(); });

    if (allHaveCapacity) {
        float const totalCapacity =
            std::accumulate(controllers.begin(), controllers.end(), 0.0f,
                            [](const float sum, ControllerData const& c) { return sum + *c.maxCurrent; });

        if (chargeLimit >= totalCapacity * 0.95f) {
            std::vector<float> limits(N);
            for (size_t i = 0; i < N; ++i) {
                limits[i] = *controllers[i].maxCurrent;
            }
            return limits;
        }
    }

    // give every controller a fixed reservation of 0.5 A before proportional
    // distribution begins. this ensures that a completely idle controller (e.g.
    // shaded panel, recently started) always receives a non-zero allowance and
    // can ramp up without waiting for the next measurement cycle to assign it
    // a larger share. if the total limit is below the combined reservation we
    // skip the proportional step and share the available budget evenly instead.
    float reserved = 0.5f;
    float const overallReserved = reserved * fN;
    float toDistribute = adjustedLimit;
    if (toDistribute > overallReserved) {
        toDistribute -= overallReserved;
    } else {
        // limit is below the reserve floor: distribute uniformly and leave
        // nothing for the proportional step
        reserved = toDistribute / fN;
        toDistribute = 0.0f;
    }

    // start every controller at its reservation; capped[] tracks which
    // controllers have already hit their hardware maximum this iteration
    std::vector limits(N, reserved);
    std::vector capped(N, false);

    // distribute toDistribute proportionally among uncapped controllers;
    // any surplus generated by maxCurrent caps feeds the next iteration.
    //
    // termination guarantee: the invariant sum(limits) + toDistribute ==
    // adjustedLimit holds throughout. because we only enter this branch when
    // adjustedLimit < totalCapacity, at least one controller must always have
    // room left, so the surplus cannot equal toDistribute and the remaining
    // budget strictly decreases with each pass.
    while (toDistribute > 0.0f) {
        // compute the total weight of all uncapped controllers. the weight of
        // each controller is max(batteryCurrent, previousLimit, reserved):
        //   - batteryCurrent  — uses actual output as the primary signal
        //   - previousLimit   — replaces a transient 0 A reading; a controller
        //                       that had a limit last cycle but now reads 0 A is
        //                       almost certainly a sampling artifact, not truly
        //                       idle, so we preserve its proportional share
        //   - reserved        — ensures every controller has a positive weight
        //                       even on first startup when both readings are 0
        float uncappedWeightSum = 0.0f;
        for (size_t i = 0; i < N; ++i) {
            if (!capped[i]) {
                auto const& c = controllers[i];
                uncappedWeightSum += std::max({ c.batteryCurrent, c.previousLimit.value_or(0.0f), reserved });
            }
        }

        // guard against floating-point edge cases where all controllers end up
        // marked capped in the same iteration despite adjustedLimit < totalCapacity
        if (uncappedWeightSum <= 0.0f) {
            break;
        }

        // assign each uncapped controller its proportional share; if that share
        // exceeds the controller's hardware maximum, cap it and collect the
        // excess as surplus to be redistributed in the next iteration
        float surplus = 0.0f;
        for (size_t i = 0; i < N; ++i) {
            if (capped[i]) {
                continue;
            }

            auto const& c = controllers[i];
            float const weight = std::max({ c.batteryCurrent, c.previousLimit.value_or(0.0f), reserved });
            limits[i] += (weight / uncappedWeightSum) * toDistribute;

            if (c.maxCurrent.has_value() && limits[i] > *c.maxCurrent) {
                surplus += limits[i] - *c.maxCurrent;
                limits[i] = *c.maxCurrent;
                capped[i] = true;
            }
        }

        toDistribute = surplus;
    }

    // VeDirectMpptController::setChargeLimit() writes the limit to a VE.Direct
    // register that has 0.1 A resolution. truncate each limit to that resolution
    // and carry any fractional remainder forward as spillover to the next
    // controller so that the sum of written limits stays as close as possible to
    // adjustedLimit. the spillover is taken from the final (possibly capped)
    // value so that budget displaced by a hardware cap is also forwarded rather
    // than silently dropped.
    float spillover = 0.0f;
    for (size_t i = 0; i < N; ++i) {
        float const l = limits[i] + spillover;
        float const r = std::floor(l * 10.0f) / 10.0f;
        limits[i] = controllers[i].maxCurrent.has_value() ? std::min(r, *controllers[i].maxCurrent) : r;
        spillover = l - limits[i];
    }

    return limits;
}

} // namespace SolarChargers
